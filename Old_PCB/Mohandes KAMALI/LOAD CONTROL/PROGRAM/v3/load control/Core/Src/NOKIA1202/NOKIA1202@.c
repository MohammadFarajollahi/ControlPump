#include "courier7x14.c"
#include "Font14x16.c"
#include "delay.c"


#define NOKIA1202_RESET_Pin       GPIO_PIN_6
#define NOKIA1202_RESET_GPIO_Port GPIOA
#define NOKIA1202_RESET_Rcc       __HAL_RCC_GPIOA_CLK_ENABLE();

#define NIKIA1202_CS_Pin          GPIO_PIN_4
#define NIKIA1202_CS_GPIO_Port    GPIOA
#define NOKIA1202_CS_Rcc          __HAL_RCC_GPIOA_CLK_ENABLE();

#define NOKIA1202_MOSI_Pin        GPIO_PIN_7
#define NOKIA1202_MOSI_GPIO_Port  GPIOA
#define NOKIA1202_MOSI_Rcc        __HAL_RCC_GPIOA_CLK_ENABLE();
  
#define NOKIA1202_SCK_Pin         GPIO_PIN_5
#define NOKIA1202_SCK_GPIO_Port   GPIOA
#define NOKIA1202_SCK_Rcc         __HAL_RCC_GPIOA_CLK_ENABLE();
const unsigned short setting[] = 
{
	64,64,
	0x00,0x00,0x80,0xE0,0xF0,0xF8,0xF8,0xFC,
	0xFC,0xFC,0xFC,0xFC,0xFC,0xFC,0xFC,0xF8,
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	0x00,0x00,0x00,0x00,0x00,0x00,0x00,0x00,
	};

const unsigned short save[] = 
{
	56,56,
	0xF0,0xF8,0xFC,0xFC,0xFE,0xFE,0x0E,0x06,
	0x06,0x06,0x06,0x06,0x06,0x06,0x06,0x06,
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	0x07,0x03,0x01,0x00,0x00,0x00,0x00,0x00,
	};
const unsigned short attention[] = 
{
	56,56,
	0x0F,0x3F,0xFF,0xFF,0xFF,0xE7,0x87,0x07,
	0x07,0x07,0x07,0x07,0x07,0x07,0x07,0x07,
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	0x00,0x00,0x00,0x00,0x00,0x00,0x00,0x00,
	};
const unsigned short just_open[] = 
{
	48,40,
	0xFF,0xFF,0xFF,0x00,0xFF,0xFF,0xFF,0xFF,
	0xFF,0xFF,0x00,0x00,0x00,0x00,0x00,0x00,
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	0x7F,0x7F,0x00,0x7F,0x7F,0x7F,0x00,0x00,
	};
const unsigned short auto_l[] = 
{
	40,48,
	0xF8,0xF8,0xF8,0xF8,0xF8,0xF8,0x00,0x00,
	0x20,0x70,0xF8,0xFC,0xF8,0xF0,0xC0,0x80,
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	0x07,0x07,0x07,0x07,0x07,0x00,0x00,0x00,
	};
const unsigned short logo[] = 
{
	96,24,
	0x03,0x07,0x1F,0xFF,0xFF,0xA3,0xE2,0xE0,
	0xE0,0xE3,0xFF,0xFF,0xFF,0xFF,0xFF,0xFF,
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	0x1F,0x0F,0x0F,0x07,0x00,0x00,0x00,0x00,
	};
const unsigned short only_i[] = 
{
  40,48,
	0xFC,0xFC,0xFC,0xFC,0xFC,0xFC,0x00,0x00,
	0x00,0x00,0x00,0x00,0x00,0xC0,0xE0,0xF8,
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	0x01,0x01,0x01,0x01,0x01,0x00,0x00,0x00,
	};
const unsigned short only_o[] = 
{
	40,48,
	0xFF,0xFF,0xFF,0xFF,0xFF,0xFF,0x00,0x00,
	0x00,0x00,0x00,0x00,0x00,0x00,0x00,0x00,
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	0x00,0x00,0x00,0x00,0x00,0x00,0x00,0x00,
	};
const unsigned short lock[] = 
{
	32,48,
	0x00,0x00,0x80,0xE0,0xF0,0xF0,0xF8,0xFC,
	0xFE,0xFE,0xFE,0xFF,0xFF,0x7F,0x7F,0x7F,
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	0x07,0x03,0x01,0x00,0x00,0x00,0x00,0x00,
	};
const unsigned short snow[] = 
{
	40,40,
	0x00,0x00,0x00,0x00,0x00,0x00,0xC0,0xC0,
	0xC0,0xC0,0xC0,0xC0,0x70,0xFC,0xF8,0xF8,
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	0x03,0x03,0x00,0x00,0x00,0x00,0x00,0x00,
	};

const unsigned char font_data[] = { 
	0x00,0x00,0x00,0x00,0x00,
	0x00,0x00,0xF6,0x00,0x00,
	0x00,0xE0,0x00,0xE0,0x00,
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	0x20,0x40,0x20,0x10,0x20,
};
#define LCD_DATA 0x100


void LCD_NOKIA1202_CLS(void);
void lcdHome(void);
void lcdRow(char r);
void lcdCol(char c);
void LCD_NOKIA1202(char line,char cloumn,char* s,char toggle);
void xputc(char r,char toggle);
void lcdSpi(int d);


void lcd_nokia1202_init(void)
{
	  GPIO_InitTypeDef GPIO_InitStruct;
	
	NOKIA1202_SCK_Rcc
	NOKIA1202_MOSI_Rcc
	NOKIA1202_CS_Rcc
	NOKIA1202_RESET_Rcc


  GPIO_InitStruct.Pin = NOKIA1202_RESET_Pin;
  GPIO_InitStruct.Mode = GPIO_MODE_OUTPUT_PP;
  GPIO_InitStruct.Speed = GPIO_SPEED_FREQ_HIGH;
  HAL_GPIO_Init(NOKIA1202_RESET_GPIO_Port, &GPIO_InitStruct);
	
	 GPIO_InitStruct.Pin = NIKIA1202_CS_Pin;
  GPIO_InitStruct.Mode = GPIO_MODE_OUTPUT_PP;
  GPIO_InitStruct.Speed = GPIO_SPEED_FREQ_HIGH;
  HAL_GPIO_Init(NIKIA1202_CS_GPIO_Port, &GPIO_InitStruct);
	
	 GPIO_InitStruct.Pin = NOKIA1202_MOSI_Pin;
  GPIO_InitStruct.Mode = GPIO_MODE_OUTPUT_PP;
  GPIO_InitStruct.Speed = GPIO_SPEED_FREQ_HIGH;
  HAL_GPIO_Init(NOKIA1202_MOSI_GPIO_Port, &GPIO_InitStruct);	
	
	
	GPIO_InitStruct.Pin = NOKIA1202_SCK_Pin ;
  GPIO_InitStruct.Mode = GPIO_MODE_OUTPUT_PP;
  GPIO_InitStruct.Speed = GPIO_SPEED_FREQ_HIGH;
  HAL_GPIO_Init(NOKIA1202_SCK_GPIO_Port, &GPIO_InitStruct);
	
   NOKIA1202_RESET_GPIO_Port->ODR &=~NOKIA1202_RESET_Pin;
HAL_Delay(10);	
   NOKIA1202_RESET_GPIO_Port->ODR |=NOKIA1202_RESET_Pin;
   NIKIA1202_CS_GPIO_Port->ODR |=NIKIA1202_CS_Pin;
	 HAL_Delay(50);
	 NIKIA1202_CS_GPIO_Port->ODR &= ~NIKIA1202_CS_Pin;	 
	 
	 	delay_us(4000);	
	
	lcdSpi(0xE2); // SW reset.
delay_us(4000);	
	
	lcdSpi(0xA4);
	delay_us(4000);	
	

	
	lcdSpi(0x2F);
	delay_us(4000);	
	lcdSpi(0xAF);
	delay_us(4000);
	
		lcdSpi(0xc8);
		delay_us(4000);	
		


	
	lcdSpi(0x80 | 0x0f);// set contrast
	delay_us(4000);	
	
	LCD_NOKIA1202_CLS();


	// v--- Likely these aren't needed...And might not be working :P ---v
delay_us(4000);	
	
	lcdSpi(0xef);	// Set refresh rate
	delay_us(4000);	
	lcdSpi(3);		// 65 Hz
	delay_us(4000);	
	lcdSpi(0x3d);	// Set Charge Pump multiply factor
	delay_us(4000);	
	lcdSpi(0);		// 5x
	delay_us(4000);	
	
	lcdSpi(0x36); // Bias ratio 1/4
	delay_us(4000);	
	
	lcdSpi(0xad);	
	delay_us(4000);	
	lcdSpi(0x20 | 15);	// 20/32
	delay_us(4000);	
	
	lcdSpi(0xe1);
	delay_us(4000);	
	lcdSpi(0);
	delay_us(4000);	
	lcdSpi(0xa6); //toggle   0xa7
delay_us(4000);	

		lcdSpi(0xA1);	// Display flipped
	delay_us(10000);	

}
//----------------------
void lcdSpi(int d)
{
	char i;
//NIKIA1202_CS_GPIO_Port->ODR &= ~NIKIA1202_CS_Pin;
//delay_us(100);	

	for(i = 0; i< 9; i++)
	{

if(d & 0x100) NOKIA1202_MOSI_GPIO_Port->ODR |=NOKIA1202_MOSI_Pin;else NOKIA1202_MOSI_GPIO_Port->ODR &= ~NOKIA1202_MOSI_Pin;
NOKIA1202_SCK_GPIO_Port->ODR &= ~NOKIA1202_SCK_Pin;	
NOKIA1202_SCK_GPIO_Port->ODR |=NOKIA1202_SCK_Pin;		
		d <<= 1;		
	}
//delay_us(1000);	
//NIKIA1202_CS_GPIO_Port->ODR |=NIKIA1202_CS_Pin;
}

//-----------------------
void LCD_NOKIA1202_CLS(void)
{
    int i;
    lcdHome();
    for(i=0; i<16*6*9; i++)
    {
        lcdSpi(LCD_DATA | 0x00); // fill DDRAM with Zeros	
    }
}

void lcdHome(void)
{
	lcdSpi(0xB0);
	lcdSpi(0x10);
	lcdSpi(0x00);
}

void lcdRow1(char r)
{
	//uint8_t row;
//switch  (r)
//{
//	
//	case 0:
//	row=7;
//	break;
//	case 1:
//	row=6;
//	break;
//	case 2:
//	row=5;
//	break;
//	case 3:
//	row=4;
//	break;			
//	case 4:
//	row=3;
//	break;	
//	case 5:
//	row=2;
//	break;	
//	case 6:
//	row=1;
//	break;	
//	case 7:
//	row=0;
//	break;	
//	

//}	
//r=row;
	
	lcdSpi(0xB0 | (r & 0x0F));
}
void lcdRow(char r)
{
	uint8_t row;
switch  (r)
{
	
	case 0:
	row=7;
	break;
	case 1:
	row=6;
	break;
	case 2:
	row=5;
	break;
	case 3:
	row=4;
	break;			
	case 4:
	row=3;
	break;	
	case 5:
	row=2;
	break;	
	case 6:
	row=1;
	break;	
	case 7:
	row=0;
	break;	
	

}	
r=row;
	
	lcdSpi(0xB0 | (r & 0x0F));
}

void lcdCol(char c)
{
	lcdSpi(0x10 | (c>>4)); // Sets the DDRAM column addr - upper 3-bit
    lcdSpi(0x00 | (c & 0x0F)); // lower 4-bit
}


void LCD_NOKIA1202(char line,char cloumn,char* s,char toggle)
{
	lcdHome();
	lcdRow(line);
	lcdCol(cloumn);
	while(*s)
	{
		xputc(*s++,toggle);
	}
}
//--------------------------------------------------
void xputc(char r,char toggle)
{
	char i,j;
	
	int d = r - ' ';
	d *= 5;

	
	for(i = 0; i< 5; i++)
	{
	if(toggle==0)j=font_data[d++];else	j=~font_data[d++];
				
		lcdSpi(LCD_DATA | j);
	}
	
	if(toggle==0)lcdSpi(LCD_DATA | 0x00);else lcdSpi(LCD_DATA | 0xff); // 1px gap after each letter
	
}



//-----------------------

//-------------------------------------------------- 
void LCD_PCD8544(uint8_t Row,uint8_t Column,char * text)
{
uint8_t i,position;	
unsigned int i1;
	

i1=strlen(text);		
	
for(position=0;position<i1;position++)
{	

lcdRow(Row);	
lcdCol((Column+(position*7)));	


for(i=0;i<=6;i++)lcdSpi(LCD_DATA |(courier7x14[(i+(text[position]*14)+4)-(32*14)]));	
//for(i=0;i<=6;i++)lcdSpi(LCD_DATA | 0xFF);	
	
lcdRow((Row+1));	
lcdCol((Column)+(position*7));	

for(i=7;i<=13;i++)lcdSpi(LCD_DATA |(courier7x14[(i+(text[position]*14)+4)-(32*14)]));	
}

}
//---------------------------------------------------------------

void putchar14x16_xy(uint8_t Row,uint8_t Column,char * text)
{
uint8_t i=0,j=0,k=0,position=0;	
unsigned int i1;
uint16_t lcd[16];	
	
	
i1=strlen(text);
	
for(position=0;position<i1;position++){
	
for(k=0;k<15;k++){
lcd[k]=0;	
for(i=15,j=0;i>0;i--,j++)	  if((Font14x16[(i+(text[position]*16))-(32*16)]) & (0x0001<<k))(lcd[k] |=(0x0001<<j));
}
	
lcd[0]=0;lcd[15]=0;	
	
lcdRow(Row+1);	
lcdCol((Column+(position*12)));	
	
		for(i=15;i>0;i--)	lcdSpi(LCD_DATA |((uint8_t)lcd[i]));	
	
lcdRow(Row);	
lcdCol((Column+(position*12)));
	
		for(i=15;i>0;i--)	lcdSpi(LCD_DATA |((uint8_t)(lcd[i]>>=8)));	
	
}	

}
//---------------------------------------------- lcd icon
void show_icon(int x,int y,const unsigned short *data){
    int i,j,k;
	
    lcdHome();
    k=data[0];	
		for(j=0;j<(data[1]/8);j++){
		lcdRow1(j+x);	
    lcdCol(y);			
    for(i=0; i<k; i++)
    {
        lcdSpi(LCD_DATA | data[2+(i+(j*k))]); // fill DDRAM with Zeros	

    }
	}
	
}	







